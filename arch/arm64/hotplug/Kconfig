## arch/arm64/hotplug/Kconfig
```kconfig
config BLU_PLUG
	bool "Dynamic hotplug driver"
	depends on HOTPLUG_CPU
	default n
	help
	Automatically hotplugs the multiple cpu cores on and off
	based on cpu load and suspend stat
          The Dynamic hotplug driver automatically online/offline CPUs proportional to system load.
```
